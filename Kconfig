## Kconfig
```kconfig
# SPDX-License-Identifier: GPL-2.0-only
config MT76_CORE
	tristate

config MT76_LEDS
	bool
	depends on MT76_CORE
	depends on LEDS_CLASS=y || MT76_CORE=LEDS_CLASS
	default y

config MT76_USB
        tristate
        depends on MT76_CORE

source "drivers/net/wireless/mt76/mt7615/Kconfig"
```
